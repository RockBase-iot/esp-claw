## components/lua_modules/lua_module_imu/Kconfig
```kconfig
menu "Lua IMU Module"

    choice LUA_MODULE_IMU_CHIP
        prompt "IMU chip model"
        default LUA_MODULE_IMU_CHIP_BMI270
        help
            Select which IMU backend this Lua module should build against.

        config LUA_MODULE_IMU_CHIP_BMI270
            bool "BMI270"
            help
                Build the IMU Lua module with the BMI270 backend.

        config LUA_MODULE_IMU_CHIP_MPU6050
            bool "MPU6050"
            help
                Reserved for a future MPU6050 backend. The code path is not
                implemented yet and will fail at compile time if selected.
    endchoice

endmenu
```
